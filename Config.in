## configs/keel_qemu_x86_64_defconfig
```kconfig
BR2_x86_64=y
BR2_PACKAGE_HOST_LINUX_HEADERS_CUSTOM_6_12=y
BR2_TOOLCHAIN_BUILDROOT_GLIBC=y
BR2_TOOLCHAIN_BUILDROOT_CXX=y
BR2_JLEVEL=4
BR2_REPRODUCIBLE=y
BR2_TARGET_GENERIC_HOSTNAME="keel"
BR2_TARGET_GENERIC_ISSUE="keel2 v0.1"
# BR2_TARGET_GENERIC_REMOUNT_ROOTFS_RW is not set
BR2_INIT_SYSTEMD=y
BR2_INIT_SYSTEMD_VAR_NONE=y
BR2_PACKAGE_SYSTEMD_BOOT=y
BR2_TARGET_GENERIC_GETTY_PORT="ttyS0"
BR2_ROOTFS_OVERLAY="$(BR2_EXTERNAL_KEEL_PATH)/board/qemu/x86_64/rootfs-overlay"
BR2_ROOTFS_POST_BUILD_SCRIPT="$(BR2_EXTERNAL_KEEL_PATH)/board/qemu/x86_64/post-build.sh"
BR2_LINUX_KERNEL=y
BR2_LINUX_KERNEL_CUSTOM_VERSION=y
BR2_LINUX_KERNEL_CUSTOM_VERSION_VALUE="6.12.117"
BR2_LINUX_KERNEL_USE_CUSTOM_CONFIG=y
BR2_LINUX_KERNEL_CUSTOM_CONFIG_FILE="$(BR2_EXTERNAL_KEEL_PATH)/board/qemu/x86_64/linux.config"
BR2_LINUX_KERNEL_CONFIG_FRAGMENT_FILES="$(BR2_EXTERNAL_KEEL_PATH)/board/qemu/x86_64/linux.fragment"
BR2_LINUX_KERNEL_NEEDS_HOST_LIBELF=y
BR2_TARGET_ROOTFS_CPIO=y
BR2_TARGET_ROOTFS_EROFS=y
# BR2_TARGET_ROOTFS_TAR is not set
BR2_ROOTFS_POST_IMAGE_SCRIPT="$(BR2_EXTERNAL_KEEL_PATH)/board/qemu/x86_64/post-image.sh"
BR2_PACKAGE_LVM2=y
BR2_PACKAGE_UTIL_LINUX_BINARIES=y
BR2_PACKAGE_UTIL_LINUX_PARTX=y
BR2_PACKAGE_UTIL_LINUX_WIPEFS=y
BR2_PACKAGE_BTRFS_PROGS=y
BR2_PACKAGE_EROFS_UTILS=y
BR2_PACKAGE_DOSFSTOOLS=y
BR2_PACKAGE_DOSFSTOOLS_MKFS_FAT=y
BR2_PACKAGE_GPTFDISK=y
BR2_PACKAGE_GPTFDISK_SGDISK=y
BR2_PACKAGE_E2FSPROGS=y
BR2_PACKAGE_KEEL_INSTALL=y
BR2_PACKAGE_BUSYBOX_CONFIG_FRAGMENT_FILES="$(BR2_EXTERNAL_KEEL_PATH)/board/qemu/x86_64/busybox.fragment"
```

## package/keel-install/Config.in
```kconfig
config BR2_PACKAGE_KEEL_INSTALL
	bool "keel-install"
	depends on BR2_x86_64
	help
	  keel2 disk installer. The binary is installed into the images
	  directory and only the recovery tree picks it up; it never enters
	  the system root.
```
